## firmware-v2/main/Kconfig.projbuild
```kconfig
menu "ESP32 Crypto Alert V2"

    config MD_USE_EXCHANGE_BITVAVO
        bool "Market data: Bitvavo exchange (REST+WS)"
        default y
        help
            Zet uit voor mock-only feed (CI/offline zonder netwerk).

    config NET_WIFI_STA_SSID
        string "WiFi STA SSID (leeg = geen WiFi)"
        default ""
        help
            Vereist voor live Bitvavo. Leeg laat WiFi uit (alleen net stack init).

    config NET_WIFI_STA_PASS
        string "WiFi STA password"
        default ""
        help
            WPA2-PSK; leeg als open netwerk (niet aanbevolen).
            Alleen fallback als NVS leeg is (ontwikkelaars); normaal: onboarding portal.

    config WIFI_ONBOARDING_FORCE
        bool "WiFi: wis NVS-credentials en start altijd provisioning (SoftAP)"
        default n
        help
            Test/factory: bij boot worden wifi_ssid/wifi_pass gewist en opent de portal opnieuw.

    choice DISPLAY_DIAG_PROFILE
        prompt "Display: A/B diagnoseprofiel (wissel → fullclean + build)"
        default DISPLAY_DIAG_PROFILE_SWAP_OFF
        help
            Standaard **ESP32-S3 GEEK**: profiel 1 (LVGL swap_bytes=0, RGB, 27 MHz) — field-test bevestigd.
            Eén profiel per build; zet swap_bytes, rgb_order en SPI-klok.
            Als de seriële log niet verandert: rm build sdkconfig sdkconfig.old && idf.py set-target esp32s3

        config DISPLAY_DIAG_PROFILE_BASELINE
            bool "0 — swap=1, RGB, 27 MHz (alternatief / diagnose)"

        config DISPLAY_DIAG_PROFILE_SWAP_OFF
            bool "1 — swap=0, RGB, 27 MHz (standaard GEEK, ST7789+LVGL 9)"

        config DISPLAY_DIAG_PROFILE_BGR
            bool "2 — swap=1, BGR, 27 MHz (esp_lcd rgb order)"

        config DISPLAY_DIAG_PROFILE_SPI_20M
            bool "3 — swap=1, RGB, 20 MHz SPI"
    endchoice

    config UI_LVGL_SWAP_BYTES
        int
        range 0 1
        default 0 if DISPLAY_DIAG_PROFILE_SWAP_OFF
        default 1
        help
            Afgeleid van Display diagnoseprofiel (hier niet handmatig zetten).

    config DISPLAY_ST7789_BGR_ORDER
        int
        range 0 1
        default 1 if DISPLAY_DIAG_PROFILE_BGR
        default 0
        help
            Afgeleid van Display diagnoseprofiel.

    config DISPLAY_SPI_PCLK_HZ
        int
        range 8000000 40000000
        default 20000000 if DISPLAY_DIAG_PROFILE_SPI_20M
        default 27000000
        help
            Afgeleid van Display diagnoseprofiel.

    config NTFY_CLIENT_ENABLE
        bool "M-011a: NTFY-notificaties (HTTPS, eerste sink)"
        default n
        help
            Publiceert via ntfy achter `service_outbound`. Zonder topic: geen netwerk.

    config NTFY_SERVER
        string "NTFY server (basis-URL, geen slash aan einde)"
        default "https://ntfy.sh"
        depends on NTFY_CLIENT_ENABLE
        help
            Bijv. https://ntfy.sh of eigen host.

    config NTFY_TOPIC
        string "NTFY topic (leeg = geen push)"
        default ""
        depends on NTFY_CLIENT_ENABLE

    config NTFY_ACCESS_TOKEN
        string "NTFY Bearer-token (optioneel)"
        default ""
        depends on NTFY_CLIENT_ENABLE
        help
            Leeg voor open topic op ntfy.sh; anders Authorization: Bearer …

    config MQTT_BRIDGE_ENABLE
        bool "M-012a: MQTT-bridge (minimaal publish)"
        default n
        help
            Eerste MQTT-pad achter service_outbound. Zonder broker-URI: geen client.

    config MQTT_BROKER_URI
        string "MQTT broker URI (leeg = uit)"
        default ""
        depends on MQTT_BRIDGE_ENABLE
        help
            Bijv. mqtt://192.168.1.10:1883 of mqtts://host:8883

    config MQTT_BRIDGE_USER
        string "MQTT gebruikersnaam (optioneel)"
        default ""
        depends on MQTT_BRIDGE_ENABLE

    config MQTT_BRIDGE_PASSWORD
        string "MQTT wachtwoord (optioneel)"
        default ""
        depends on MQTT_BRIDGE_ENABLE

    config MQTT_TOPIC_BOOT
        string "MQTT topic voor ApplicationReady (payload: online)"
        default "cryptoalert/v2/status"
        depends on MQTT_BRIDGE_ENABLE

    config MQTT_TOPIC_DOMAIN_ALERT_1M
        string "M-012b: MQTT topic voor 1m domeinalert (JSON)"
        default "cryptoalert/v2/alert/1m"
        depends on MQTT_BRIDGE_ENABLE
        help
            Compacte JSON: symbol, dir, price_eur, pct_1m, ts_ms.

    config MQTT_TOPIC_DOMAIN_ALERT_5M
        string "M-010c: MQTT topic voor 5m domeinalert (JSON)"
        default "cryptoalert/v2/alert/5m"
        depends on MQTT_BRIDGE_ENABLE
        help
            Zelfde vorm als 1m-topic; veld pct_5m.

    config MQTT_TOPIC_DOMAIN_ALERT_CONF_1M5M
        string "M-010d: MQTT topic voor 1m+5m confluence (JSON)"
        default "cryptoalert/v2/alert/conf_1m5m"
        depends on MQTT_BRIDGE_ENABLE
        help
            JSON: symbol, dir, price_eur, pct_1m, pct_5m, ts_ms.

    config WEBUI_ENABLE
        bool "M-013a: read-only status-web (HTTP)"
        default n
        help
            GET / en /api/status.json — geen POST, geen auth. Standaard poort 8080.

    config WEBUI_PORT
        int "WebUI TCP-poort"
        range 1024 65535
        default 8080
        depends on WEBUI_ENABLE

    config ALERT_ENGINE_1M_THRESHOLD_BPS
        int "M-010a: 1m move alert threshold (honderdsten %; 16 = 0,16%)"
        range 1 1000
        default 16
        help
            Absolute 1-minuut procentuele prijsbeweging (|pct|) vóór een alert-event.
            Waarde gedeeld door 100 = drempel in procent (bijv. 16 → 0,16 %, 100 → 1,00 %).

    config ALERT_ENGINE_1M_COOLDOWN_S
        int "M-010a: cooldown tussen 1m-alerts (seconden)"
        range 10 3600
        default 120
        help
            Minimum tijd tussen twee DomainAlert1mMove-events.

    config ALERT_ENGINE_5M_THRESHOLD_BPS
        int "M-010c: 5m move alert threshold (honderdsten %; 32 = 0,32%)"
        range 1 2000
        default 32
        help
            Absolute 5-minuten procentuele prijsbeweging (|pct|) vóór DomainAlert5mMove.

    config ALERT_ENGINE_5M_COOLDOWN_S
        int "M-010c: cooldown tussen 5m-alerts (seconden)"
        range 60 7200
        default 300
        help
            Minimum tijd tussen twee DomainAlert5mMove-events.

    config ALERT_ENGINE_CONF_1M5M_COOLDOWN_S
        int "M-010d: cooldown tussen confluence-alerts (1m+5m, seconden)"
        range 60 7200
        default 600
        help
            Minimum tijd tussen twee DomainAlertConfluence1m5m-events (los van 1m/5m cooldowns).

    config ALERT_ENGINE_CONF_SUPPRESS_LOOSE_S
        int "M-010e: venster na confluence — onderdruk losse 1m/5m zelfde richting (seconden)"
        range 1 120
        default 8
        help
            Na een DomainAlertConfluence1m5m worden losse 1m/5m-alerts met dezelfde richting
            tijdelijk niet verstuurd (dubbelmeldingen beperken). Tegenovergestelde richting blijft mogelijk.

    config ALERT_REGIME_VOL_WINDOW_SEC
        int "M-010f: vol-venster (seconden) voor gem. |Δ| tussen canonieke secondes"
        range 30 300
        default 90
        help
            Rolling venster op de canonieke prijsring; langere vensters = stabielere vol-schatting.

    config ALERT_REGIME_VOL_MIN_PAIRS
        int "M-010f: minimaal aantal ~1s-stappen in venster (vol metric)"
        range 8 120
        default 30

    config ALERT_REGIME_VOL_PAIR_MIN_MS
        int "M-010f: minimum ms tussen samples voor opeenvolgende stap"
        range 400 1500
        default 800

    config ALERT_REGIME_VOL_PAIR_MAX_MS
        int "M-010f: maximum ms tussen samples voor opeenvolgende stap"
        range 1200 5000
        default 2200

    config ALERT_REGIME_CALM_MAX_STEP_BPS
        int "M-010f: gem. stap (bps) strikt onder deze waarde ⇒ calm"
        range 1 80
        default 6
        help
            1 bp = 0,01 %. Lage gemiddelde stap ⇒ rustiger markt.

    config ALERT_REGIME_HOT_MIN_STEP_BPS
        int "M-010f: gem. stap (bps) vanaf deze waarde ⇒ hot"
        range 5 200
        default 28

    config ALERT_REGIME_THR_SCALE_CALM_PERMILLE
        int "M-010f: drempelschaal calm (‰ van basis, 900 = 0,90×)"
        range 700 1000
        default 900

    config ALERT_REGIME_THR_SCALE_NORMAL_PERMILLE
        int "M-010f: drempelschaal normal (‰)"
        range 950 1050
        default 1000

    config ALERT_REGIME_THR_SCALE_HOT_PERMILLE
        int "M-010f: drempelschaal hot (‰, >1000 = strengere drempel)"
        range 1000 1500
        default 1180

    config ALERT_REGIME_THR_SCALE_MIN_PERMILLE
        int "M-010f: clamp ondergrens effectieve schaal (‰)"
        range 600 950
        default 750

    config ALERT_REGIME_THR_SCALE_MAX_PERMILLE
        int "M-010f: clamp bovengrens effectieve schaal (‰)"
        range 1000 1600
        default 1350

endmenu
```

## firmware-v2/sdkconfig.defaults
```kconfig
# Standaard voor eerste referentieboard: ESP32-S3 (o.a. ESP32-S3 GEEK).
# ESP-IDF baseline: v5.4.2 (zie ESP_IDF_VERSION en BUILD.md).
# Build: idf.py set-target esp32s3 && idf.py build
# (Target staat in sdkconfig na set-target — niet hard forceren in defaults.)

CONFIG_ESP_DEFAULT_CPU_FREQ_MHZ_240=y
CONFIG_FREERTOS_HZ=1000

# Main draait app_core::run() → market_data::tick() met HTTPS (esp_http_client + mbedTLS).
# 3584 was te klein: stack overflow na STA_GOT_IP bij eerste Bitvavo REST/WS.
CONFIG_ESP_MAIN_TASK_STACK_SIZE=8192

# T-103: HTTPS naar api.bitvavo.com / wss (TLS bundle)
CONFIG_MBEDTLS_CERTIFICATE_BUNDLE_DEFAULT_FULL=y

# SoftAP onboarding: mobiele browsers sturen vaak >512 B aan HTTP-headers (431 zonder deze verhoging)
CONFIG_HTTPD_MAX_REQ_HDR_LEN=2048

# S3-GEEK: fysiek 16 MB flash — align met partition table (geen 2 MB header-cap)
CONFIG_ESPTOOLPY_FLASHSIZE_16MB=y
CONFIG_ESPTOOLPY_FLASHSIZE="16MB"

# V2: dual OTA, 3 MiB per app-slot — zie partitions_v2_16mb_ota.csv + docs/flash/PARTITIONS_V2.md
CONFIG_PARTITION_TABLE_CUSTOM=y
CONFIG_PARTITION_TABLE_CUSTOM_FILENAME="partitions_v2_16mb_ota.csv"

# S3-GEEK ST7789 + LVGL: vastgelegd productprofiel — swap_bytes=0, RGB, 27 MHz (zie GEEK_DISPLAY_DIAG.md)
CONFIG_DISPLAY_DIAG_PROFILE_SWAP_OFF=y

# M-003a / M-013b: runtime service-toggles/poort/URI/topic — defaults uit Kconfig; NVS-overlay (schema v3, keys svc_*); M-013b: POST /api/services.json schrijft alleen mqtt/ntfy (geen webui_*).
# M-011a: NTFY staat default uit; zet CONFIG_NTFY_CLIENT_ENABLE=y + NTFY_TOPIC via menuconfig voor echte push.
# M-012a: MQTT-bridge default uit; zet CONFIG_MQTT_BRIDGE_ENABLE=y + MQTT_BROKER_URI voor echte publish.
# M-013a: read-only status-web — standaard aan (poort 8080); NVS `svc_wui_en` kan runtime uitzetten.
CONFIG_WEBUI_ENABLE=y
CONFIG_WEBUI_PORT=8080

# S30-1: canonieke prijsring ~32 min (1800s venster + 120s marge) voor 30m-%-metric.
CONFIG_DOMAIN_METRICS_30M_WINDOW_S=1800
CONFIG_DOMAIN_METRICS_CANONICAL_RING_EXTRA_S=120
# S2H-1: 2h %-move — aparte minuut-ring (~146 slots default), geen 7200×1 Hz canoniek.
CONFIG_DOMAIN_METRICS_2H_WINDOW_S=7200
CONFIG_DOMAIN_METRICS_2H_MINUTE_RING_EXTRA_SLOTS=24
# M-014a: OTA-upload via POST /api/ota (ruwe .bin); dual-slot zie partitions_v2_16mb_ota.csv.
# M-010a: domain_metrics + alert_engine — 1m-drempel 0,16% (zie ook sdkconfig).
CONFIG_ALERT_ENGINE_1M_THRESHOLD_BPS=16
CONFIG_ALERT_ENGINE_1M_COOLDOWN_S=120
CONFIG_ALERT_ENGINE_5M_THRESHOLD_BPS=32
CONFIG_ALERT_ENGINE_5M_COOLDOWN_S=300
# S30-2: 30m drempel + cooldown (Kconfig-only; outbound volgt S30-3).
CONFIG_ALERT_ENGINE_30M_THRESHOLD_BPS=64
CONFIG_ALERT_ENGINE_30M_COOLDOWN_S=1800
# S2H-2/S2H-3: 2h drempel + cooldown; outbound+observability via S2H-3 (NTFY/MQTT/alerts_2h).
CONFIG_ALERT_ENGINE_2H_THRESHOLD_BPS=128
CONFIG_ALERT_ENGINE_2H_COOLDOWN_S=7200
CONFIG_ALERT_ENGINE_CONF_1M5M_COOLDOWN_S=600
CONFIG_ALERT_ENGINE_CONF_SUPPRESS_LOOSE_S=8
CONFIG_ALERT_REGIME_VOL_WINDOW_SEC=90
CONFIG_ALERT_REGIME_VOL_MIN_PAIRS=30
CONFIG_ALERT_REGIME_VOL_PAIR_MIN_MS=800
CONFIG_ALERT_REGIME_VOL_PAIR_MAX_MS=2200
CONFIG_ALERT_REGIME_CALM_MAX_STEP_BPS=6
CONFIG_ALERT_REGIME_HOT_MIN_STEP_BPS=28
CONFIG_ALERT_REGIME_THR_SCALE_CALM_PERMILLE=900
CONFIG_ALERT_REGIME_THR_SCALE_NORMAL_PERMILLE=1000
CONFIG_ALERT_REGIME_THR_SCALE_HOT_PERMILLE=1180
CONFIG_ALERT_REGIME_THR_SCALE_MIN_PERMILLE=750
CONFIG_ALERT_REGIME_THR_SCALE_MAX_PERMILLE=1350
```

## firmware-v3/main/Kconfig.projbuild
```kconfig
menu "Crypto-Alert V3 (development WiFi)"

    config CRYPTO_ALERT_WIFI_USE_DEV_FALLBACK
        bool "Enable development WiFi fallback from menuconfig"
        default y
        help
            When NVS has no valid WiFi credentials, use SSID/password from this menu
            if SSID is non-empty. For bring-up only; replace with real provisioning later.

    config CRYPTO_ALERT_WIFI_SAVE_FALLBACK_TO_NVS
        bool "Persist dev fallback WiFi to NVS after first resolve"
        depends on CRYPTO_ALERT_WIFI_USE_DEV_FALLBACK
        default n
        help
            If fallback is used, write SSID/password/dhcp to NVS once so the next cold
            boot loads from NVS. Password is never logged.

    config CRYPTO_ALERT_WIFI_SSID
        string "Development WiFi SSID"
        depends on CRYPTO_ALERT_WIFI_USE_DEV_FALLBACK
        default ""
        help
            Leave empty to skip fallback. Max 32 characters (STA limit). Do not commit
            real credentials in sdkconfig.defaults.

    config CRYPTO_ALERT_WIFI_PASSWORD
        string "Development WiFi password"
        depends on CRYPTO_ALERT_WIFI_USE_DEV_FALLBACK
        default ""
        help
            May be empty for open networks. Never logged.

    config CRYPTO_ALERT_WIFI_DHCP
        bool "DHCP for development STA"
        depends on CRYPTO_ALERT_WIFI_USE_DEV_FALLBACK
        default y

endmenu

menu "Crypto-Alert V3 (NTFY)"

    config CRYPTO_ALERT_NTFY_ENABLE
        bool "Enable ntfy push notifications"
        default n

    config CRYPTO_ALERT_NTFY_SERVER_URL
        string "NTFY server base URL"
        depends on CRYPTO_ALERT_NTFY_ENABLE
        default "https://ntfy.sh"
        help
            Base server URL, without topic suffix.

    config CRYPTO_ALERT_NTFY_TOPIC
        string "NTFY topic"
        depends on CRYPTO_ALERT_NTFY_ENABLE
        default ""
        help
            Topic path on server. Leave empty to disable sends at runtime.

    config CRYPTO_ALERT_NTFY_MIN_QUALITY
        int "Minimum quality score for TRIGGERED push"
        depends on CRYPTO_ALERT_NTFY_ENABLE
        range 1 3
        default 2

    config CRYPTO_ALERT_NTFY_COOLDOWN_SEC
        int "Global notification cooldown (seconds)"
        depends on CRYPTO_ALERT_NTFY_ENABLE
        range 0 3600
        default 60

endmenu
```

## firmware-v3/sdkconfig.defaults
```kconfig
# Crypto-Alert V3 — defaults voor ESP32-S3-GEEK (16 MB flash)
# Build: idf.py set-target esp32s3 && idf.py build
# Eerste skeleton: standaard partition table; later eigen OTA-table indien nodig.

CONFIG_ESP_DEFAULT_CPU_FREQ_MHZ_240=y
CONFIG_FREERTOS_HZ=1000

CONFIG_ESP_MAIN_TASK_STACK_SIZE=8192

# TLS / wss (Bitvavo) — voorbereiding voor market_ws
CONFIG_MBEDTLS_CERTIFICATE_BUNDLE_DEFAULT_FULL=y

CONFIG_ESPTOOLPY_FLASHSIZE_16MB=y
CONFIG_ESPTOOLPY_FLASHSIZE="16MB"

# Development WiFi fallback (Crypto-Alert V3) — zet SSID/wachtwoord via idf.py menuconfig;
# laat defaults leeg; commit geen echte credentials in git.
CONFIG_CRYPTO_ALERT_WIFI_USE_DEV_FALLBACK=y
CONFIG_CRYPTO_ALERT_WIFI_SAVE_FALLBACK_TO_NVS=n
CONFIG_CRYPTO_ALERT_WIFI_SSID=""
CONFIG_CRYPTO_ALERT_WIFI_PASSWORD=""
CONFIG_CRYPTO_ALERT_WIFI_DHCP=y

# NTFY defaults (disabled by default; topic intentionally empty)
CONFIG_CRYPTO_ALERT_NTFY_ENABLE=n
CONFIG_CRYPTO_ALERT_NTFY_SERVER_URL="https://ntfy.sh"
CONFIG_CRYPTO_ALERT_NTFY_TOPIC=""
CONFIG_CRYPTO_ALERT_NTFY_MIN_QUALITY=2
CONFIG_CRYPTO_ALERT_NTFY_COOLDOWN_SEC=60
```
